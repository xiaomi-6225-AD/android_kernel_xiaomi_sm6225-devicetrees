/dts-v1/;
/plugin/;

#include "khaje-camera-sensor-idp.dtsi"
#include "khaje-camera-sensor-nopmi.dtsi"
/ {
	model = "Qualcomm Technologies, Inc. KHAJE IDP nopmi tapas";
	compatible = "qcom,khaje-idp", "qcom,khaje", "qcom,idp";
	qcom,msm-id = <586 0x10000>;
	qcom,board-id = <0x30022 0>;
	qcom,pmic-id = <0x2D 0x0 0x0 0x0>;
};

